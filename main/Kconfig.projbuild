## main/Kconfig.projbuild
```kconfig
menu "Remote GNSS"

    menu "WiFi"

        config RGNSS_AP_SSID
            string "Access point name"
            default "haydamaka-f9p-gnss" if RGNSS_GNSS_F9P
            default "haydamaka-puck-gnss"
            help
                Open (passwordless) access point the device brings up when it has no
                station network, or can't reach it. Station credentials come from the
                web page, or else from WIFI_STA_SSID / WIFI_STA_PASSWORD in
                main/wifi_credentials.h.

        config RGNSS_AP_CHANNEL
            int "Access point channel"
            range 1 13
            default 1

        config RGNSS_AP_MAX_CONN
            int "Access point max clients"
            range 1 10
            default 4

        config RGNSS_STA_FALLBACK_S
            int "Seconds without a station connection before the access point comes up"
            range 5 600
            default 30

    endmenu

    config RGNSS_HOSTNAME
        string "mDNS hostname (without .local)"
        default "haydamaka-f9p-gnss" if RGNSS_GNSS_F9P
        default "haydamaka-puck-gnss"
        help
            A single label: ESP-IDF's mDNS responder writes a dotted name such as
            "gnss.haydamaka" into its replies as one label, which resolvers reject.

    config RGNSS_HTTP_PORT
        int "Web server port"
        range 1 65535
        default 80

    menu "Magnetometer calibration"

        config RGNSS_CAL_GOOD_PERMILLE
            int "Fit error for a good calibration (per mille)"
            range 5 200
            default 25
            help
                A session finishes by itself once the readings sit this close to
                the sphere: 25 means 2.5 %.

        config RGNSS_CAL_ROUGH_PERMILLE
            int "Fit error still worth saving (per mille)"
            range 10 500
            default 60
            help
                Worse than good but usable. Such a calibration is saved and
                labelled rough, and the page warns about it.

        config RGNSS_CAL_COVERAGE_PCT
            int "Share of directions that must be covered (%)"
            range 50 100
            default 90

    endmenu

    menu "GNSS"

        choice RGNSS_GNSS_RECEIVER
            prompt "Receiver"
            default RGNSS_GNSS_WS181
            help
                Which receiver this firmware is built for. It decides the rate
                the UART starts at and what, if anything, is sent to set the
                receiver up: see main/gnss_ws181.c and main/gnss_f9p.c. The
                rest of the GNSS code is the same either way.

            config RGNSS_GNSS_WS181
                bool "Walksnail WS-M181 (u-blox M10, compass on board)"

            config RGNSS_GNSS_F9P
                bool "u-blox ZED-F9P (RTK, no compass)"

        endchoice

        config RGNSS_GNSS_RATE_HZ
            int "Navigation rate (Hz)"
            range 1 20
            default 5
            depends on RGNSS_GNSS_F9P
            help
                Solutions per second. The F9P reaches 20 Hz on GPS alone but
                only 7-8 Hz with every constellation and RTK, so leave room.
                The WS-M181 is left at whatever Walksnail set, which is 10 Hz.

        comment "Leave GPIO 2, 8, 9, 20 and 21 alone: strapping pin, LED, BOOT and the console"
            depends on IDF_TARGET_ESP32C3
        comment "Leave GPIO 0, 2, 5, 12, 15 (strapping), 6-11 (flash) and 1, 3 (console) alone; 34-39 are inputs without pull-ups"
            depends on IDF_TARGET_ESP32

        config RGNSS_GNSS_RX_GPIO
            int "UART RX GPIO (receiver TX)"
            range 0 39 if IDF_TARGET_ESP32
            range 0 21
            default 16 if IDF_TARGET_ESP32
            default 4

        config RGNSS_GNSS_TX_GPIO
            int "UART TX GPIO (receiver RX)"
            range 0 39 if IDF_TARGET_ESP32
            range 0 21
            default 17 if IDF_TARGET_ESP32
            default 3

        config RGNSS_GNSS_BAUD
            int "Baud rate"
            default 115200
            help
                The rate the link should end up running at. gnss.c hunts across
                the usual rates whatever this says, so it is a preference rather
                than a requirement - but a receiver that can be told (the F9P)
                is told to move here, because the 38400 baud it arrives at
                carries about 3.8 kB/s and a multi-constellation stream above
                3 Hz is more than that.

    endmenu

    menu "NMEA output"

        config RGNSS_NMEA_SUBSCRIBERS
            int "Outputs the sentence stream can feed at once"
            range 1 12
            default 5
            help
                One per connected TCP client, plus one for the BLE link, so the
                default matches four TCP clients and BLE. Each costs a buffer,
                and they are all allocated at start-up.

        config RGNSS_NMEA_COMPASS_BELOW_KMH
            int "Send the compass heading as the course below this speed (km/h, 0 for never)"
            range 0 100
            default 5
            help
                Slower than this the course over ground is noise, so the RMC and
                VTG sent over TCP and BLE carry the compass heading instead:
                true in RMC and in VTG's true field, magnetic in VTG's
                magnetic field. Only with a fix, a calibrated magnetometer and
                the declination known; otherwise the receiver's course goes
                out as it came.

        config RGNSS_NMEA_TYPES
            string "Sentence types to send (empty for all)"
            default "RMC,GGA,GSA,VTG,GLL,GST,ZDA,HDG,HDT,RMB,BWC"
            help
                A comma-separated list of three-letter sentence types, matched
                whatever the talker. The receiver's default is 10 Hz with every
                constellation's GSV, which is about 6 KB/s and three quarters of
                it satellites-in-view; that saturates the link with more than one
                client and is far past what BLE can carry. Leaving GSV out of
                this list keeps the position, accuracy and time sentences.
                HDG and HDT are the compass (gnss.c, 2 Hz); RMB and BWC the
                way to the destination set with WPL (waypoint.c, 1 Hz). Empty
                sends everything.

        config RGNSS_TCP_ENABLED
            bool "Serve NMEA over TCP"
            default y

        config RGNSS_TCP_PORT
            int "TCP port"
            range 1 65535
            default 10110
            depends on RGNSS_TCP_ENABLED
            help
                10110 is the registered port for NMEA-0183 navigational data.
                gpsd takes it as tcp://host:10110.

        config RGNSS_TCP_MAX_CLIENTS
            int "TCP clients at once"
            range 1 8
            default 4
            depends on RGNSS_TCP_ENABLED

        config RGNSS_BLE_ENABLED
            bool "Serve NMEA over BLE (Nordic UART Service)"
            default y
            help
                Needs Bluetooth and NimBLE enabled, which sdkconfig.defaults does.
                BLE only, no SPP: the ESP32-C3 has no Bluetooth Classic, and the
                ESP32 build leaves it out to keep the two the same.

        config RGNSS_LED_GPIO
            int "GPIO of the status LED"
            range 0 39 if IDF_TARGET_ESP32
            range 0 21
            default 2 if IDF_TARGET_ESP32
            default 8
            help
                The SuperMini's blue LED, or the WROOM DevKit's on GPIO 2. See
                led.h for what it shows.

        config RGNSS_LED_ACTIVE_LOW
            bool "The LED is lit when the GPIO is driven low"
            default n if IDF_TARGET_ESP32
            default y
            help
                The SuperMini's LED hangs from 3.3 V and lights when the pin
                sinks; the DevKit's sits between the pin and ground.

        config RGNSS_RADIO_SWITCH_GPIO
            int "GPIO of the WiFi/BLE switch"
            range 0 39 if IDF_TARGET_ESP32
            range 0 21
            default 27 if IDF_TARGET_ESP32
            default 10
            depends on RGNSS_BLE_ENABLED
            help
                A switch to ground chooses the radio: on the puck, on (closed) is
                WiFi and off (open, held high by the internal pull-up) is BLE;
                RGNSS_RADIO_SWITCH_OPEN_IS_BLE turns that round. Flipping it
                restarts the device on the other one.

        config RGNSS_RADIO_SWITCH_OPEN_IS_BLE
            bool "An open switch, or none fitted, means BLE"
            default n if IDF_TARGET_ESP32
            default y
            depends on RGNSS_BLE_ENABLED
            help
                Which radio the pull-up alone chooses. The puck has the switch
                and boots on BLE with it open. A board without one wants WiFi
                that way, so that it can be reached and updated; grounding the
                pin then chooses BLE.

    endmenu

    menu "Magnetometer"

        comment "Leave GPIO 2, 8, 9, 20 and 21 alone: strapping pin, LED, BOOT and the console"
            depends on IDF_TARGET_ESP32C3
        comment "Leave GPIO 0, 2, 5, 12, 15 (strapping), 6-11 (flash) and 1, 3 (console) alone; 34-39 are inputs without pull-ups"
            depends on IDF_TARGET_ESP32

        config RGNSS_MAG_SDA_GPIO
            int "I2C SDA GPIO"
            range 0 39 if IDF_TARGET_ESP32
            range 0 21
            default 21 if IDF_TARGET_ESP32
            default 1

        config RGNSS_MAG_SCL_GPIO
            int "I2C SCL GPIO"
            range 0 39 if IDF_TARGET_ESP32
            range 0 21
            default 22 if IDF_TARGET_ESP32
            default 0

    endmenu

endmenu
```
